## CMakeLists.txt
```
cmake_minimum_required(VERSION 3.20.0)

find_package(Zephyr REQUIRED HINTS $ENV{ZEPHYR_BASE})
project(http_client_proj)

FILE(GLOB app_sources src/*.c)
target_sources(app PRIVATE ${app_sources})

set(gen_dir ${ZEPHYR_BINARY_DIR}/include/generated/)

generate_inc_file_for_target(
    app
    src/https-cert.der
    ${gen_dir}/https-cert.der.inc
    )
```

## Kconfig
```
mainmenu "HTTP client application"

menu "Wi-Fi settings"

config APP_WIFI_SSID
	string "Wi-Fi SSID"
	default ""
	help
	  Name of the Wi-Fi network to connect to.

config APP_WIFI_PASSWORD
	string "Wi-Fi password"
	default ""
	help
	  WPA2-PSK passphrase. Compiled into the firmware image.

endmenu

source "Kconfig.zephyr"
```

## prj.conf
```kconfig
CONFIG_LOG_MODE_MINIMAL=y

CONFIG_MAIN_STACK_SIZE=4096

CONFIG_WIFI=y

CONFIG_NETWORKING=y
CONFIG_NET_IPV4=y
CONFIG_NET_IPV6=y
CONFIG_NET_TCP=y
CONFIG_NET_SOCKETS=y

CONFIG_NET_DHCPV4=y

CONFIG_DNS_RESOLVER=y


CONFIG_NET_CONFIG_INIT_TIMEOUT=30

CONFIG_NET_MGMT_EVENT_INFO=y

# CONFIG_NET_LOG=y
# CONFIG_NET_TCP_LOG_LEVEL_DBG=y   # or CONFIG_NET_TCP_LOG_LEVEL_INF
# CONFIG_NET_SOCKETS_LOG_LEVEL_DBG=y

CONFIG_MAIN_STACK_SIZE=3072
CONFIG_NET_BUF_RX_COUNT=80
CONFIG_NET_BUF_TX_COUNT=80

# TLS configuration
CONFIG_MBEDTLS=y
CONFIG_MBEDTLS_ENABLE_HEAP=y
# CONFIG_MBEDTLS_SSL_MAX_CONTENT_LEN=16384 // Depreceated
CONFIG_MBEDTLS_HEAP_SIZE=100000
CONFIG_MBEDTLS_SSL_IN_CONTENT_LEN=16384
CONFIG_MBEDTLS_SSL_OUT_CONTENT_LEN=2048
CONFIG_MBEDTLS_CIPHERSUITE_TLS_ECDHE_RSA_WITH_AES_128_CBC_SHA256=y
CONFIG_MBEDTLS_BUILTIN=y
# CONFIG_MBEDTLS_TLS_VERSION_1_2=y
# CONFIG_MBEDTLS_KEY_EXCHANGE_ALL_ENABLED=y
# CONFIG_MBEDTLS_ECP_ALL_ENABLED=y
CONFIG_MBEDTLS_CIPHER_ALL_ENABLED=y
# CONFIG_MBEDTLS_DEBUG=y
# CONFIG_MBEDTLS_LOG_LEVEL_DBG=y
CONFIG_MBEDTLS_SSL_SERVER_NAME_INDICATION=y
CONFIG_PSA_WANT_ALG_SHA_384=y
CONFIG_PSA_WANT_ALG_SHA_512=y
CONFIG_MBEDTLS_CIPHERSUITE_TLS_ECDHE_RSA_WITH_AES_128_GCM_SHA256=y
CONFIG_MBEDTLS_CIPHERSUITE_TLS_ECDHE_RSA_WITH_CHACHA20_POLY1305_SHA256=y

CONFIG_NET_SOCKETS_SOCKOPT_TLS=y
CONFIG_NET_SOCKETS_TLS_MAX_CONTEXTS=6

CONFIG_HTTP_CLIENT=y

CONFIG_MAIN_STACK_SIZE=8192
```

## boards/esp32c3_devkitc.conf
```kconfig
CONFIG_WIFI_ESP32=y
CONFIG_HEAP_MEM_POOL_SIZE=51200
```

## src/main.c
```c
#include <zephyr/kernel.h>
#include "iot_wifi.h"
#include "iot_http.h"

#define WIFI_SSID           CONFIG_APP_WIFI_SSID
#define WIFI_PSWD           CONFIG_APP_WIFI_PASSWORD

#define WIFI_MAX_RETRIES    5

int main()
{
    int ret;
    wifi_init();
    wifi_scan();

    for (int attempt = 1; attempt <= WIFI_MAX_RETRIES; attempt++) {
        printk("Wi-Fi connect attempt %d/%d...\n", attempt, WIFI_MAX_RETRIES);
        ret = wifi_connect(WIFI_SSID, WIFI_PSWD);
        if (ret == 0) {
            break;
        }
        printk("Connect attempt failed (%d), retrying...\n", ret);
        k_sleep(K_SECONDS(2));
    }

    wait_for_ip_addr();
    init_http_request();

    return 0;
}
```

## src/ca_certificate.h
```c
#define CA_CERTIFICATE_TAG 1

#define TLS_PEER_HOSTNAME "www.google.com"

static const unsigned char ca_certificate[] = {
  0x30, 0x82, 0x05, 0x57, 0x30, 0x82, 0x03, 0x3f, 0xa0, 0x03, 0x02, 0x01,
  0x02, 0x02, 0x0d, 0x02, 0x03, 0xe5, 0x93, 0x6f, 0x31, 0xb0, 0x13, 0x49,
  0x88, 0x6b, 0xa2, 0x17, 0x30, 0x0d, 0x06, 0x09, 0x2a, 0x86, 0x48, 0x86,
  0xf7, 0x0d, 0x01, 0x01, 0x0c, 0x05, 0x00, 0x30, 0x47, 0x31, 0x0b, 0x30,
  0x09, 0x06, 0x03, 0x55, 0x04, 0x06, 0x13, 0x02, 0x55, 0x53, 0x31, 0x22,
  0x30, 0x20, 0x06, 0x03, 0x55, 0x04, 0x0a, 0x13, 0x19, 0x47, 0x6f, 0x6f,
  0x67, 0x6c, 0x65, 0x20, 0x54, 0x72, 0x75, 0x73, 0x74, 0x20, 0x53, 0x65,
  0x72, 0x76, 0x69, 0x63, 0x65, 0x73, 0x20, 0x4c, 0x4c, 0x43, 0x31, 0x14,
  0x30, 0x12, 0x06, 0x03, 0x55, 0x04, 0x03, 0x13, 0x0b, 0x47, 0x54, 0x53,
  0x20, 0x52, 0x6f, 0x6f, 0x74, 0x20, 0x52, 0x31, 0x30, 0x1e, 0x17, 0x0d,
  0x31, 0x36, 0x30, 0x36, 0x32, 0x32, 0x30, 0x30, 0x30, 0x30, 0x30, 0x30,
  0x5a, 0x17, 0x0d, 0x33, 0x36, 0x30, 0x36, 0x32, 0x32, 0x30, 0x30, 0x30,
  0x30, 0x30, 0x30, 0x5a, 0x30, 0x47, 0x31, 0x0b, 0x30, 0x09, 0x06, 0x03,
  0x55, 0x04, 0x06, 0x13, 0x02, 0x55, 0x53, 0x31, 0x22, 0x30, 0x20, 0x06,
  0x03, 0x55, 0x04, 0x0a, 0x13, 0x19, 0x47, 0x6f, 0x6f, 0x67, 0x6c, 0x65,
  0x20, 0x54, 0x72, 0x75, 0x73, 0x74, 0x20, 0x53, 0x65, 0x72, 0x76, 0x69,
  0x63, 0x65, 0x73, 0x20, 0x4c, 0x4c, 0x43, 0x31, 0x14, 0x30, 0x12, 0x06,
  0x03, 0x55, 0x04, 0x03, 0x13, 0x0b, 0x47, 0x54, 0x53, 0x20, 0x52, 0x6f,
  0x6f, 0x74, 0x20, 0x52, 0x31, 0x30, 0x82, 0x02, 0x22, 0x30, 0x0d, 0x06,
  0x09, 0x2a, 0x86, 0x48, 0x86, 0xf7, 0x0d, 0x01, 0x01, 0x01, 0x05, 0x00,
  0x03, 0x82, 0x02, 0x0f, 0x00, 0x30, 0x82, 0x02, 0x0a, 0x02, 0x82, 0x02,
  0x01, 0x00, 0xb6, 0x11, 0x02, 0x8b, 0x1e, 0xe3, 0xa1, 0x77, 0x9b, 0x3b,
  0xdc, 0xbf, 0x94, 0x3e, 0xb7, 0x95, 0xa7, 0x40, 0x3c, 0xa1, 0xfd, 0x82,
  0xf9, 0x7d, 0x32, 0x06, 0x82, 0x71, 0xf6, 0xf6, 0x8c, 0x7f, 0xfb, 0xe8,
  0xdb, 0xbc, 0x6a, 0x2e, 0x97, 0x97, 0xa3, 0x8c, 0x4b, 0xf9, 0x2b, 0xf6,
  0xb1, 0xf9, 0xce, 0x84, 0x1d, 0xb1, 0xf9, 0xc5, 0x97, 0xde, 0xef, 0xb9,
  0xf2, 0xa3, 0xe9, 0xbc, 0x12, 0x89, 0x5e, 0xa7, 0xaa, 0x52, 0xab, 0xf8,
  0x23, 0x27, 0xcb, 0xa4, 0xb1, 0x9c, 0x63, 0xdb, 0xd7, 0x99, 0x7e, 0xf0,
  0x0a, 0x5e, 0xeb, 0x68, 0xa6, 0xf4, 0xc6, 0x5a, 0x47, 0x0d, 0x4d, 0x10,
  0x33, 0xe3, 0x4e, 0xb1, 0x13, 0xa3, 0xc8, 0x18, 0x6c, 0x4b, 0xec, 0xfc,
  0x09, 0x90, 0xdf, 0x9d, 0x64, 0x29, 0x25, 0x23, 0x07, 0xa1, 0xb4, 0xd2,
  0x3d, 0x2e, 0x60, 0xe0, 0xcf, 0xd2, 0x09, 0x87, 0xbb, 0xcd, 0x48, 0xf0,
  0x4d, 0xc2, 0xc2, 0x7a, 0x88, 0x8a, 0xbb, 0xba, 0xcf, 0x59, 0x19, 0xd6,
  0xaf, 0x8f, 0xb0, 0x07, 0xb0, 0x9e, 0x31, 0xf1, 0x82, 0xc1, 0xc0, 0xdf,
  0x2e, 0xa6, 0x6d, 0x6c, 0x19, 0x0e, 0xb5, 0xd8, 0x7e, 0x26, 0x1a, 0x45,
  0x03, 0x3d, 0xb0, 0x79, 0xa4, 0x94, 0x28, 0xad, 0x0f, 0x7f, 0x26, 0xe5,
  0xa8, 0x08, 0xfe, 0x96, 0xe8, 0x3c, 0x68, 0x94, 0x53, 0xee, 0x83, 0x3a,
  0x88, 0x2b, 0x15, 0x96, 0x09, 0xb2, 0xe0, 0x7a, 0x8c, 0x2e, 0x75, 0xd6,
  0x9c, 0xeb, 0xa7, 0x56, 0x64, 0x8f, 0x96, 0x4f, 0x68, 0xae, 0x3d, 0x97,
  0xc2, 0x84, 0x8f, 0xc0, 0xbc, 0x40, 0xc0, 0x0b, 0x5c, 0xbd, 0xf6, 0x87,
  0xb3, 0x35, 0x6c, 0xac, 0x18, 0x50, 0x7f, 0x84, 0xe0, 0x4c, 0xcd, 0x92,
  0xd3, 0x20, 0xe9, 0x33, 0xbc, 0x52, 0x99, 0xaf, 0x32, 0xb5, 0x29, 0xb3,
  0x25, 0x2a, 0xb4, 0x48, 0xf9, 0x72, 0xe1, 0xca, 0x64, 0xf7, 0xe6, 0x82,
  0x10, 0x8d, 0xe8, 0x9d, 0xc2, 0x8a, 0x88, 0xfa, 0x38, 0x66, 0x8a, 0xfc,
  0x63, 0xf9, 0x01, 0xf9, 0x78, 0xfd, 0x7b, 0x5c, 0x77, 0xfa, 0x76, 0x87,
  0xfa, 0xec, 0xdf, 0xb1, 0x0e, 0x79, 0x95, 0x57, 0xb4, 0xbd, 0x26, 0xef,
  0xd6, 0x01, 0xd1, 0xeb, 0x16, 0x0a, 0xbb, 0x8e, 0x0b, 0xb5, 0xc5, 0xc5,
  0x8a, 0x55, 0xab, 0xd3, 0xac, 0xea, 0x91, 0x4b, 0x29, 0xcc, 0x19, 0xa4,
  0x32, 0x25, 0x4e, 0x2a, 0xf1, 0x65, 0x44, 0xd0, 0x02, 0xce, 0xaa, 0xce,
  0x49, 0xb4, 0xea, 0x9f, 0x7c, 0x83, 0xb0, 0x40, 0x7b, 0xe7, 0x43, 0xab,
  0xa7, 0x6c, 0xa3, 0x8f, 0x7d, 0x89, 0x81, 0xfa, 0x4c, 0xa5, 0xff, 0xd5,
  0x8e, 0xc3, 0xce, 0x4b, 0xe0, 0xb5, 0xd8, 0xb3, 0x8e, 0x45, 0xcf, 0x76,
  0xc0, 0xed, 0x40, 0x2b, 0xfd, 0x53, 0x0f, 0xb0, 0xa7, 0xd5, 0x3b, 0x0d,
  0xb1, 0x8a, 0xa2, 0x03, 0xde, 0x31, 0xad, 0xcc, 0x77, 0xea, 0x6f, 0x7b,
  0x3e, 0xd6, 0xdf, 0x91, 0x22, 0x12, 0xe6, 0xbe, 0xfa, 0xd8, 0x32, 0xfc,
  0x10, 0x63, 0x14, 0x51, 0x72, 0xde, 0x5d, 0xd6, 0x16, 0x93, 0xbd, 0x29,
  0x68, 0x33, 0xef, 0x3a, 0x66, 0xec, 0x07, 0x8a, 0x26, 0xdf, 0x13, 0xd7,
  0x57, 0x65, 0x78, 0x27, 0xde, 0x5e, 0x49, 0x14, 0x00, 0xa2, 0x00, 0x7f,
  0x9a, 0xa8, 0x21, 0xb6, 0xa9, 0xb1, 0x95, 0xb0, 0xa5, 0xb9, 0x0d, 0x16,
  0x11, 0xda, 0xc7, 0x6c, 0x48, 0x3c, 0x40, 0xe0, 0x7e, 0x0d, 0x5a, 0xcd,
  0x56, 0x3c, 0xd1, 0x97, 0x05, 0xb9, 0xcb, 0x4b, 0xed, 0x39, 0x4b, 0x9c,
  0xc4, 0x3f, 0xd2, 0x55, 0x13, 0x6e, 0x24, 0xb0, 0xd6, 0x71, 0xfa, 0xf4,
  0xc1, 0xba, 0xcc, 0xed, 0x1b, 0xf5, 0xfe, 0x81, 0x41, 0xd8, 0x00, 0x98,
  0x3d, 0x3a, 0xc8, 0xae, 0x7a, 0x98, 0x37, 0x18, 0x05, 0x95, 0x02, 0x03,
  0x01, 0x00, 0x01, 0xa3, 0x42, 0x30, 0x40, 0x30, 0x0e, 0x06, 0x03, 0x55,
  0x1d, 0x0f, 0x01, 0x01, 0xff, 0x04, 0x04, 0x03, 0x02, 0x01, 0x86, 0x30,
  0x0f, 0x06, 0x03, 0x55, 0x1d, 0x13, 0x01, 0x01, 0xff, 0x04, 0x05, 0x30,
  0x03, 0x01, 0x01, 0xff, 0x30, 0x1d, 0x06, 0x03, 0x55, 0x1d, 0x0e, 0x04,
  0x16, 0x04, 0x14, 0xe4, 0xaf, 0x2b, 0x26, 0x71, 0x1a, 0x2b, 0x48, 0x27,
  0x85, 0x2f, 0x52, 0x66, 0x2c, 0xef, 0xf0, 0x89, 0x13, 0x71, 0x3e, 0x30,
  0x0d, 0x06, 0x09, 0x2a, 0x86, 0x48, 0x86, 0xf7, 0x0d, 0x01, 0x01, 0x0c,
  0x05, 0x00, 0x03, 0x82, 0x02, 0x01, 0x00, 0x9f, 0xaa, 0x42, 0x26, 0xdb,
  0x0b, 0x9b, 0xbe, 0xff, 0x1e, 0x96, 0x92, 0x2e, 0x3e, 0xa2, 0x65, 0x4a,
  0x6a, 0x98, 0xba, 0x22, 0xcb, 0x7d, 0xc1, 0x3a, 0xd8, 0x82, 0x0a, 0x06,
  0xc6, 0xf6, 0xa5, 0xde, 0xc0, 0x4e, 0x87, 0x66, 0x79, 0xa1, 0xf9, 0xa6,
  0x58, 0x9c, 0xaa, 0xf9, 0xb5, 0xe6, 0x60, 0xe7, 0xe0, 0xe8, 0xb1, 0x1e,
  0x42, 0x41, 0x33, 0x0b, 0x37, 0x3d, 0xce, 0x89, 0x70, 0x15, 0xca, 0xb5,
  0x24, 0xa8, 0xcf, 0x6b, 0xb5, 0xd2, 0x40, 0x21, 0x98, 0xcf, 0x22, 0x34,
  0xcf, 0x3b, 0xc5, 0x22, 0x84, 0xe0, 0xc5, 0x0e, 0x8a, 0x7c, 0x5d, 0x88,
  0xe4, 0x35, 0x24, 0xce, 0x9b, 0x3e, 0x1a, 0x54, 0x1e, 0x6e, 0xdb, 0xb2,
  0x87, 0xa7, 0xfc, 0xf3, 0xfa, 0x81, 0x55, 0x14, 0x62, 0x0a, 0x59, 0xa9,
  0x22, 0x05, 0x31, 0x3e, 0x82, 0xd6, 0xee, 0xdb, 0x57, 0x34, 0xbc, 0x33,
  0x95, 0xd3, 0x17, 0x1b, 0xe8, 0x27, 0xa2, 0x8b, 0x7b, 0x4e, 0x26, 0x1a,
  0x7a, 0x5a, 0x64, 0xb6, 0xd1, 0xac, 0x37, 0xf1, 0xfd, 0xa0, 0xf3, 0x38,
  0xec, 0x72, 0xf0, 0x11, 0x75, 0x9d, 0xcb, 0x34, 0x52, 0x8d, 0xe6, 0x76,
  0x6b, 0x17, 0xc6, 0xdf, 0x86, 0xab, 0x27, 0x8e, 0x49, 0x2b, 0x75, 0x66,
  0x81, 0x10, 0x21, 0xa6, 0xea, 0x3e, 0xf4, 0xae, 0x25, 0xff, 0x7c, 0x15,
  0xde, 0xce, 0x8c, 0x25, 0x3f, 0xca, 0x62, 0x70, 0x0a, 0xf7, 0x2f, 0x09,
  0x66, 0x07, 0xc8, 0x3f, 0x1c, 0xfc, 0xf0, 0xdb, 0x45, 0x30, 0xdf, 0x62,
  0x88, 0xc1, 0xb5, 0x0f, 0x9d, 0xc3, 0x9f, 0x4a, 0xde, 0x59, 0x59, 0x47,
  0xc5, 0x87, 0x22, 0x36, 0xe6, 0x82, 0xa7, 0xed, 0x0a, 0xb9, 0xe2, 0x07,
  0xa0, 0x8d, 0x7b, 0x7a, 0x4a, 0x3c, 0x71, 0xd2, 0xe2, 0x03, 0xa1, 0x1f,
  0x32, 0x07, 0xdd, 0x1b, 0xe4, 0x42, 0xce, 0x0c, 0x00, 0x45, 0x61, 0x80,
  0xb5, 0x0b, 0x20, 0x59, 0x29, 0x78, 0xbd, 0xf9, 0x55, 0xcb, 0x63, 0xc5,
  0x3c, 0x4c, 0xf4, 0xb6, 0xff, 0xdb, 0x6a, 0x5f, 0x31, 0x6b, 0x99, 0x9e,
  0x2c, 0xc1, 0x6b, 0x50, 0xa4, 0xd7, 0xe6, 0x18, 0x14, 0xbd, 0x85, 0x3f,
  0x67, 0xab, 0x46, 0x9f, 0xa0, 0xff, 0x42, 0xa7, 0x3a, 0x7f, 0x5c, 0xcb,
  0x5d, 0xb0, 0x70, 0x1d, 0x2b, 0x34, 0xf5, 0xd4, 0x76, 0x09, 0x0c, 0xeb,
  0x78, 0x4c, 0x59, 0x05, 0xf3, 0x33, 0x42, 0xc3, 0x61, 0x15, 0x10, 0x1b,
  0x77, 0x4d, 0xce, 0x22, 0x8c, 0xd4, 0x85, 0xf2, 0x45, 0x7d, 0xb7, 0x53,
  0xea, 0xef, 0x40, 0x5a, 0x94, 0x0a, 0x5c, 0x20, 0x5f, 0x4e, 0x40, 0x5d,
  0x62, 0x22, 0x76, 0xdf, 0xff, 0xce, 0x61, 0xbd, 0x8c, 0x23, 0x78, 0xd2,
  0x37, 0x02, 0xe0, 0x8e, 0xde, 0xd1, 0x11, 0x37, 0x89, 0xf6, 0xbf, 0xed,
  0x49, 0x07, 0x62, 0xae, 0x92, 0xec, 0x40, 0x1a, 0xaf, 0x14, 0x09, 0xd9,
  0xd0, 0x4e, 0xb2, 0xa2, 0xf7, 0xbe, 0xee, 0xee, 0xd8, 0xff, 0xdc, 0x1a,
  0x2d, 0xde, 0xb8, 0x36, 0x71, 0xe2, 0xfc, 0x79, 0xb7, 0x94, 0x25, 0xd1,
  0x48, 0x73, 0x5b, 0xa1, 0x35, 0xe7, 0xb3, 0x99, 0x67, 0x75, 0xc1, 0x19,
  0x3a, 0x2b, 0x47, 0x4e, 0xd3, 0x42, 0x8e, 0xfd, 0x31, 0xc8, 0x16, 0x66,
  0xda, 0xd2, 0x0c, 0x3c, 0xdb, 0xb3, 0x8e, 0xc9, 0xa1, 0x0d, 0x80, 0x0f,
  0x7b, 0x16, 0x77, 0x14, 0xbf, 0xff, 0xdb, 0x09, 0x94, 0xb2, 0x93, 0xbc,
  0x20, 0x58, 0x15, 0xe9, 0xdb, 0x71, 0x43, 0xf3, 0xde, 0x10, 0xc3, 0x00,
  0xdc, 0xa8, 0x2a, 0x95, 0xb6, 0xc2, 0xd6, 0x3f, 0x90, 0x6b, 0x76, 0xdb,
  0x6c, 0xfe, 0x8c, 0xbc, 0xf2, 0x70, 0x35, 0x0c, 0xdc, 0x99, 0x19, 0x35,
  0xdc, 0xd7, 0xc8, 0x46, 0x63, 0xd5, 0x36, 0x71, 0xae, 0x57, 0xfb, 0xb7,
  0x82, 0x6d, 0xdc
};
```

## src/iot_http.c
```c
#include <zephyr/kernel.h>
#include <zephyr/net/socket.h>
#include <zephyr/net/http/client.h>
#include <zephyr/net/tls_credentials.h>
#include "ca_certificate.h"
#include "iot_http.h"

#define MAX_RECV_BUF_LEN 512

static uint8_t recv_buf_ipv4[MAX_RECV_BUF_LEN];

static int setup_socket(net_sa_family_t sa_family, const char *server, int port, int *sock, struct net_sockaddr *addr, net_socklen_t addr_len) {

    int ret = 0;
    const char *family_str = (sa_family == NET_AF_INET) ? "IPv4" : "IPv6";

    memset(addr, 0, addr_len);

    struct zsock_addrinfo hints = {0};
    struct zsock_addrinfo *res = NULL;
    char port_str[6];

    hints.ai_family = sa_family;
    hints.ai_socktype = NET_SOCK_STREAM;
    sprintf(port_str, "%d", port);

    ret = zsock_getaddrinfo(server, port_str, &hints, &res);
    if(ret < 0 || res == NULL) {
        printk("Cannot resolve %s address (%d)\n", family_str, -errno);
        return -EHOSTUNREACH;
    }

    memcpy(addr, res->ai_addr, MIN(res->ai_addrlen, addr_len));
    zsock_freeaddrinfo(res);

    if(IS_ENABLED(CONFIG_NET_SOCKETS_SOCKOPT_TLS)) {
        sec_tag_t sec_tag_list[] = { CA_CERTIFICATE_TAG };
        *sock = zsock_socket(sa_family, NET_SOCK_STREAM, NET_IPPROTO_TLS_1_2);
        if(*sock >= 0) {
            ret = zsock_setsockopt(*sock, ZSOCK_SOL_TLS, ZSOCK_TLS_SEC_TAG_LIST, sec_tag_list, sizeof(sec_tag_list));
            if(ret < 0) {
                printk("Failed to set %s secure option (%d)\n", family_str, -errno);
                ret = -errno;
            }
            ret = zsock_setsockopt(*sock, ZSOCK_SOL_TLS, ZSOCK_TLS_HOSTNAME, HOSTNAME, sizeof(TLS_PEER_HOSTNAME));
            if(ret < 0) {
                printk("Failed to set %s TLS_HOSTNAME option (%d)\n", family_str, -errno);
                ret = -errno;
            }
        }
    } else {
        *sock = zsock_socket(sa_family, NET_SOCK_STREAM, NET_IPPROTO_TCP);
    }

    if(*sock < 0) {
        printk("Failed to create %s HTTP socket (%d)\n", family_str, -errno);
        return ret;
    }

    return 0;
}

static int connect_socket(net_sa_family_t sa_family, const char *server, int port, int *sock, struct net_sockaddr *addr, net_socklen_t addr_len) {

    int ret = 0;

    ret = setup_socket(sa_family, server, port, sock, addr, addr_len);
    if(ret < 0 || *sock < 0) {
        return -1;
    }

    ret = zsock_connect(*sock, addr, addr_len);
    if(ret < 0) {
        printk("Cannot connect to %s remote (%d)\n", (sa_family == NET_AF_INET) ? "IPv4" : "IPv6", -errno);
        zsock_close(*sock);
        *sock = -1;
        ret = -errno;
    }

    return ret;
}

static int response_cb(struct http_response *rsp, enum http_final_call final_data, void *user_data) {
    
    if(final_data == HTTP_DATA_MORE) {
        printk("Partial data received (%zu bytes)\n", rsp->data_len);
    } else if(final_data == HTTP_DATA_FINAL) {
        printk("All the data received (%zu bytes)\n", rsp->data_len);
    }

    // printk("Response status %s\n", rsp->http_status);
    // printk("Response data: %.*s\n", (int)rsp->data_len, rsp->recv_buf);

    return 0;
}

void init_http_request(void) {

    struct net_sockaddr_in addrv4 = {0};
    struct net_sockaddr_in6 addrv6 = {0};
    int sock4 = -1, sock6 = -1;
    int ret = 0;
    int32_t timeout = 3 * MSEC_PER_SEC;
    int port = HTTPS_PORT;
    struct http_request req;

    if(IS_ENABLED(CONFIG_NET_SOCKETS_SOCKOPT_TLS)) {

        ret = tls_credential_add(CA_CERTIFICATE_TAG, TLS_CREDENTIAL_CA_CERTIFICATE, ca_certificate, sizeof(ca_certificate));

        if(ret < 0) {
            printk("Failed to register public certificate: %d\n", ret);
            return;
        }

        port = HTTPS_PORT;
    }

    if(IS_ENABLED(CONFIG_NET_IPV4)) {

        
        connect_socket(NET_AF_INET, HOSTNAME, port, &sock4, (struct net_sockaddr *)&addrv4, sizeof(addrv4));
        if(sock4 < 0) {
            printk("Cannot create HTTP IPv4 connection.\n");
            return;
        }

        char ip[NET_IPV4_ADDR_LEN];
        zsock_inet_ntop(AF_INET, &addrv4.sin_addr, ip, sizeof(ip));
        printk("Connecting to %s:%d\n", ip, ntohs(addrv4.sin_port));
        
        memset(&req, 0, sizeof(req));

        req.method = HTTP_GET;
        req.url = "/";
		req.host = HOSTNAME;
		req.protocol = "HTTP/1.1";
		req.response = response_cb;
		req.recv_buf = recv_buf_ipv4;
		req.recv_buf_len = sizeof(recv_buf_ipv4);

        ret = http_client_req(sock4, &req, timeout, NULL);
        if(ret < 0) {
            printk("Client error %d\n", ret);
        }

        zsock_close(sock4);

    }

    sock4 = -1;

}
```

## src/iot_http.h
```c
#ifndef IOT_HTTP_H
#define IOT_HTTP_H

#define HOSTNAME         "www.google.com" 
#define HTTP_PORT        80
#define HTTPS_PORT       443

void init_http_request(void);


#endif /* IOT_HTTP_H */
```

## src/iot_wifi.c
```c
#include <zephyr/logging/log.h>
LOG_LEVEL_SET(LOG_LEVEL_DBG);

#include <zephyr/kernel.h>
#include <zephyr/net/net_mgmt.h>
#include <zephyr/net/wifi_mgmt.h>

BUILD_ASSERT(sizeof(CONFIG_APP_WIFI_SSID) > 1, "Set Wi-Fi SSID");

static struct net_mgmt_event_callback wifi_mgmt_cb;
static struct net_mgmt_event_callback wifi_scan_cb;
static struct net_mgmt_event_callback ip_mgmt_cb;

K_SEM_DEFINE(wifi_mgmt_sem, 0, 1);
K_SEM_DEFINE(wifi_scan_sem, 0, 1);
K_SEM_DEFINE(ip_mgmt_sem, 0, 1);

void wifi_event_handler(struct net_mgmt_event_callback *cb, uint64_t mgmt_event, struct net_if *iface) {
    struct wifi_status *status = (struct wifi_status *)cb->info;
    if(mgmt_event == NET_EVENT_WIFI_CONNECT_RESULT) {
        if (status->status == 0) {
            printk("Wi-Fi connected successfully\n");
            k_sem_give(&wifi_mgmt_sem);
        } else {
            printk("Wi-Fi connection failed with status: %d\n", status->status);
            // k_sem_give(&wifi_mgmt_sem); // Release semaphore even on failure to avoid deadlock
        }
    } else if (mgmt_event == NET_EVENT_WIFI_DISCONNECT_RESULT) {
        if(status->status == 0) {
            printk("Wi-Fi disconnected successfully\n");
            k_sem_take(&wifi_mgmt_sem, K_NO_WAIT);
            k_sem_take(&ip_mgmt_sem, K_NO_WAIT);
        } else {
            printk("Wi-Fi disconnection failed with status: %d\n", status->status);
            k_sem_give(&wifi_mgmt_sem); // Release semaphore even on failure to avoid deadlock
        }
    }
}

static void on_wifi_scan_result(struct net_mgmt_event_callback *cb) {
    const struct wifi_scan_result *entry = (const struct wifi_scan_result *)cb->info;
    char ssid_str[WIFI_SSID_MAX_LEN + 1];

    memset(ssid_str, 0, sizeof(entry->ssid));
    memcpy(ssid_str, entry->ssid, entry->ssid_length);

    printk("  SSID: %-32s | Chan: %-3u | RSSI: %-4d | Band: %s | Security: %s\n",
           ssid_str,
           entry->channel,
           entry->rssi,
           wifi_band_txt(entry->band),
           wifi_security_txt(entry->security));
}

static void on_wifi_scan_done(struct net_mgmt_event_callback *cb) {
    const struct wifi_status *status = (const struct wifi_status *)cb->info;
    if (status->status) {
        printk("Scan failed (%d)\n", status->status);
    } else {
        printk("Scan complete.\n");
    }
    k_sem_give(&wifi_scan_sem);
}

void on_scan_handler(struct net_mgmt_event_callback *cb, uint64_t mgmt_event, struct net_if *iface) {
    switch (mgmt_event) {
        case NET_EVENT_WIFI_SCAN_RESULT:
            on_wifi_scan_result(cb);
            break;
        case NET_EVENT_WIFI_SCAN_DONE:
            on_wifi_scan_done(cb);
            break;
        default:
            break;
    }
}

void on_ip_acquired_handler(struct net_mgmt_event_callback *cb, uint64_t mgmt_event, struct net_if *iface) {
    if (mgmt_event == NET_EVENT_IPV4_ADDR_ADD) {
        printk("IP address acquired event received\n");
        k_sem_give(&ip_mgmt_sem);
    }
}

void wifi_init(void) {
    // Initializing the network management event callback for Wi-Fi events
    net_mgmt_init_event_callback(&wifi_mgmt_cb, wifi_event_handler, NET_EVENT_WIFI_CONNECT_RESULT | NET_EVENT_WIFI_DISCONNECT_RESULT);
    net_mgmt_init_event_callback(&wifi_scan_cb, on_scan_handler, NET_EVENT_WIFI_SCAN_RESULT | NET_EVENT_WIFI_SCAN_DONE);
    net_mgmt_init_event_callback(&ip_mgmt_cb, on_ip_acquired_handler, NET_EVENT_IPV4_ADDR_ADD);

    // Adding the Wi-Fi event callback to the network management system
    net_mgmt_add_event_callback(&wifi_mgmt_cb);
    net_mgmt_add_event_callback(&wifi_scan_cb);
    net_mgmt_add_event_callback(&ip_mgmt_cb);
}

void wifi_scan(void) {
    struct net_if *iface = net_if_get_default();
    int ret;

    printk("Scanning for Wi-Fi networks...\n");

    ret = net_mgmt(NET_REQUEST_WIFI_SCAN, iface, NULL, 0);
    if (ret) {
        printk("Scan request failed (%d)\n", ret);
        return;
    }

    k_sem_take(&wifi_scan_sem, K_SECONDS(10)); // Wait for scan to complete
}

int wifi_connect(const char *ssid, const char *pswd) {
    int ret;
    struct wifi_connect_req_params params;
    struct net_if *iface = net_if_get_default();

    memset(&params, 0, sizeof(params));
    params.ssid = (const uint8_t *)ssid;
    params.ssid_length = strlen(ssid);
    params.psk = (const uint8_t *)pswd;
    params.psk_length = strlen(pswd);
    params.security = WIFI_SECURITY_TYPE_PSK;
    params.channel = WIFI_CHANNEL_ANY;
    params.band = WIFI_FREQ_BAND_2_4_GHZ;
    params.mfp = WIFI_MFP_OPTIONAL;

    ret = net_mgmt(NET_REQUEST_WIFI_CONNECT, iface, &params, sizeof(params));
    if (ret) {
        printk("Wi-Fi connect request failed (%d)\n", ret);
        return ret;
    }

    // if(k_sem_take(&wifi_mgmt_sem, K_SECONDS(10)) != 0) {
    //     printk("Wi-Fi connection timed out\n");
    //     return -EAGAIN;
    // }

    return ret;
}

void wait_for_ip_addr(void) {
    int ret;
    struct wifi_iface_status status;
    struct net_if *iface = net_if_get_default();

    char ip_addr[NET_IPV4_ADDR_LEN];
    char gw_addr[NET_IPV4_ADDR_LEN];

    k_sem_take(&ip_mgmt_sem, K_FOREVER);

    memset(&ip_addr, 0, sizeof(ip_addr));
    if(net_addr_ntop(NET_AF_INET, &iface->config.ip.ipv4->unicast[0].ipv4.address.in_addr, ip_addr, sizeof(ip_addr)) == NULL) {
        printk("Error: Could not convert IP address to string\r\n");
    }

    memset(&gw_addr, 0, sizeof(gw_addr));
    if(net_addr_ntop(NET_AF_INET, &iface->config.ip.ipv4->gw, gw_addr, sizeof(gw_addr)) == NULL) {
        printk("Error: Could not convert gateway address to string\r\n");
    }

    ret = net_mgmt(NET_REQUEST_WIFI_IFACE_STATUS, iface, &status, sizeof(status));
    if (ret) {
        printk("Failed to get Wi-Fi interface status (%d)\n", ret);
        return;
    }

    printk("WiFi status:\r\n");
    if (status.state >= WIFI_STATE_ASSOCIATED) {
        printk("  SSID: %-32s\r\n", status.ssid);
        printk("  Band: %s\r\n", wifi_band_txt(status.band));
        printk("  Channel: %d\r\n", status.channel);
        printk("  Security: %s\r\n", wifi_security_txt(status.security));
        printk("  IP address: %s\r\n", ip_addr);
        printk("  Gateway: %s\r\n", gw_addr);
    }   // Wait for the device to obtain an IP address
}

int wifi_disconnect(void) {
    struct net_if *iface = net_if_get_default();
    int ret = net_mgmt(NET_REQUEST_WIFI_DISCONNECT, iface, NULL, 0);
    if (ret) {
        printk("Wi-Fi disconnect request failed (%d)\n", ret);
        return ret;
    }
    return 0;
}
```

## src/iot_wifi.h
```c
#ifndef IOT_WIFI_H
#define IOT_WIFI_H       

void wifi_init(void);
void wifi_scan(void);
int wifi_connect(const char *ssid, const char *pswd);
void wait_for_ip_addr(void);
int wifi_disconnect(void);

#endif /* IOT_WIFI_H */
```
